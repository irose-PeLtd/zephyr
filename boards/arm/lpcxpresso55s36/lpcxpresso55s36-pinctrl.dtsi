/*
 * NOTE: File generated by lpc_cfg_utils.py
 * from LPCXpresso55S06.mex
 *
 * Copyright 2022 NXP
 * SPDX-License-Identifier: Apache-2.0
 */


#include <nxp/lpc/LPC55S36JBD100-pinctrl.h>

&pinctrl {
	pinmux_flexcomm0_usart: pinmux_flexcomm0_usart {
		group0 {
			pinmux = <FC3_TXD_SCL_MISO_WS_PIO0_2>,
				<FC3_RXD_SDA_MOSI_DATA_PIO0_3>;
			slew-rate = "standard";
		};
	};

};
