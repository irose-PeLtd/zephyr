## boards/arm/lpcxpresso55s36/Kconfig.board
```kconfig
# LPCXpresso55S06 board

# Copyright (c) 2022 metraTec
# SPDX-License-Identifier: Apache-2.0

config BOARD_LPCXPRESSO55S36
	bool "NXP LPCXPRESSO-55S36"
	depends on SOC_SERIES_LPC55XXX
	select SOC_PART_NUMBER_LPC55S36JBD100
```

## boards/arm/lpcxpresso55s36/Kconfig.defconfig
```kconfig
# LPCXpresso55S06 board

# Copyright (c) 2022 metraTec
# SPDX-License-Identifier: Apache-2.0

if BOARD_LPCXPRESSO55S36

config BOARD
	default "lpcxpresso55s36"

endif # BOARD_LPCXPRESSO55S36
```
